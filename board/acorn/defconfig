## board/acorn/defconfig
```kconfig
# Arch
CONFIG_ARCH_ARM=y

# Board
CONFIG_BOARD="acorn"
CONFIG_SYS_PROMPT="acorn_debug: "

# Image
CONFIG_BASE_ADDRESS=0x10000000
CONFIG_FMAP_OFFSET=0x00100000
CONFIG_HEAP_SIZE=0x00600000
CONFIG_KERNEL_START=0x11000000
CONFIG_ATAG_BASE=0x1f000000

# Kernel format
CONFIG_KERNEL_ZIMAGE=y
CONFIG_KERNEL_LEGACY=y

CONFIG_HEADLESS=y
CONFIG_CLI=y

# Drivers
CONFIG_DRIVER_FLASH_SPI=y
CONFIG_MOCK_TPM=y
CONFIG_DRIVER_BUS_I2C_ARMADA38X=y
CONFIG_DRIVER_STORAGE_MTD_ARMADA38X_NAND=y
```

## board/cyclone/defconfig
```kconfig
# Arch
CONFIG_ARCH_ARM=y

# Board
CONFIG_BOARD="cyclone"
CONFIG_SYS_PROMPT="cyclone_debug: "

# Image
CONFIG_BASE_ADDRESS=0x10000000
CONFIG_FMAP_OFFSET=0x00300000
CONFIG_HEAP_SIZE=0x01000000
CONFIG_KERNEL_START=0x12000000
CONFIG_ATAG_BASE=0x1f000000

# Kernel format
CONFIG_KERNEL_ZIMAGE=y
CONFIG_KERNEL_LEGACY=y

CONFIG_HEADLESS=y
CONFIG_CLI=y

# Drivers
CONFIG_DRIVER_FLASH_SPI=y
CONFIG_MOCK_TPM=y
CONFIG_DRIVER_BUS_I2C_ARMADA38X=y
CONFIG_DRIVER_STORAGE_MTD_ARMADA38X_NAND=y
CONFIG_DRIVER_STORAGE_MTD_SPI_NAND=y
CONFIG_DRIVER_BUS_SPI_ARMADA38X_SPI=y


CONFIG_NV_STORAGE_FLASH=y
```
